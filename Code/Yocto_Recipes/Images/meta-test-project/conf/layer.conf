## Code/Yocto_Recipes/Images/meta-test-project/conf/layer.conf
```bitbake
# We have a conf and classes directory, add to BBPATH
BBPATH .= ":${LAYERDIR}"

# We have recipes-* directories, add to BBFILES
BBFILES += "${LAYERDIR}/recipes-*/*/*.bb \
            ${LAYERDIR}/recipes-*/*/*.bbappend"

BBFILE_COLLECTIONS += "meta-test-project"
BBFILE_PATTERN_meta-test-project = "^${LAYERDIR}/"
BBFILE_PRIORITY_meta-test-project = "6"

LAYERDEPENDS_meta-test-project = "core"
LAYERSERIES_COMPAT_meta-test-project = "kirkstone langdale"
```

## Code/meta-hello-world/conf/layer.conf
```bitbake
# We have a conf and classes directory, add to BBPATH
BBPATH .= ":${LAYERDIR}"

# We have recipes-* directories, add to BBFILES
BBFILES += "${LAYERDIR}/recipes-*/*/*.bb \
            ${LAYERDIR}/recipes-*/*/*.bbappend"

BBFILE_COLLECTIONS += "meta-hello-world"
BBFILE_PATTERN_meta-hello-world = "^${LAYERDIR}/"
BBFILE_PRIORITY_meta-hello-world = "6"

LAYERDEPENDS_meta-hello-world = "core"
LAYERSERIES_COMPAT_meta-hello-world = "hardknott"
```
